## firmware/components/hifi/Kconfig
```kconfig
menu "hifi-receiver lab"
	config HIFI_LAB
		bool "Lab build: experiments a signed command starts and stops"
		default n
		help
			Adds the "lab" API (esp/hifi_lab_esp.c) and its experiments
			(esp/lab_*.c). Set by board/lite-lab; off in a product image.
	config HIFI_LAB_DRILL
		bool "Rollback drill: the lab reports itself broken"
		depends on HIFI_LAB
		default n
		help
			The image's trial then fails ("the lab frame isn't up") and the
			board must roll back to the image before it by itself. Set only by
			board/lite-lab-drill, to prove that it does.
	config HIFI_LAB_DRILL_STUCK
		bool "Stuck-tick drill: the lab's tick hangs holding its lock"
		depends on HIFI_LAB
		default n
		help
			Once per power-up, 5 minutes after boot, the lab's tick hangs
			holding the lab's lock (as a stuck experiment stop would). The
			watch must restart the board within HIFI_LAB_STUCK_MS, and the
			self-test after it says "the lab restarted it, its tick stuck".
			Set only by board/lite-lab-stuck, to prove that.
	config HIFI_LAB_PSRAM_STACKS
		bool "Lab: the decode and stream threads' stacks in PSRAM, and lab_flac"
		depends on HIFI_LAB && SPIRAM_ALLOW_STACK_EXTERNAL_MEMORY
		select HIFI_PSRAM_STACKS
		default n
		help
			HIFI_PSRAM_STACKS (which lite-main sets anyway) plus the lab_flac
			experiment, 96/24 FLAC decoded on a PSRAM stack beside the radios.
			Set only by board/lite-lab-radio.
endmenu

config HIFI_PSRAM_STACKS
	bool "The decode and stream threads' stacks in PSRAM"
	depends on SPIRAM_ALLOW_STACK_EXTERNAL_MEMORY
	default n
	help
		patches/0019: squeezelite's decode (14 KB) and stream (4 KB) threads
		get their stacks from PSRAM instead of internal RAM, which a
		pthread's always is in IDF 4.4. That frees about 19 KB of internal
		RAM: the Lite had 11 KB left with Spotify playing and panicked. Such
		a thread must never touch flash, reads included (NVS, a partition,
		mmap or OTA: the IDF asserts its stack is internal while the cache
		is off), nor call Bluetooth or Wi-Fi APIs directly; neither does
		today (config_set_value only edits the RAM copy; the commit timer
		writes NVS). Set by board/lite-main.
```
